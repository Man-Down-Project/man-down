## mesh_esp_version/sdkconfig.defaults
```kconfig
CONFIG_ESP_MAIN_TASK_STACK_SIZE=7168
CONFIG_PARTITION_TABLE_OFFSET=0x8000
CONFIG_APP_OFFSET=0x20000
CONFIG_ESP_BRIDGE_EMBED_TXTFILES="src/broker_ca_cert.pem"
CONFIG_PARTITION_TABLE_CUSTOM_FILENAME="partitions.csv"
CONFIG_PARTITION_TABLE_FILENAME="partitions.csv"
CONFIG_BT_ENABLED=y
CONFIG_BT_NIMBLE_ENABLED=y
CONFIG_ESPTOOLPY_FLASHSIZE_8MB=y
CONFIG_ESPTOOLPY_FLASHSIZE="8MB"
```
